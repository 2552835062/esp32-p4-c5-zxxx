## main/Kconfig.projbuild
```kconfig
menu "歌词显示屏（ESP32-P4C5 + AXS15260）"

    config P4_WIFI_STA_SSID
        string "WiFi SSID（留空则只跑演示模式）"
        default ""
        help
            歌词页通过 WiFi 加入局域网，自动发现电脑端 music_agent.py。
            留空时不初始化 C5/WiFi，界面使用内置演示歌单。

    config P4_WIFI_STA_PASSWORD
        string "WiFi 密码"
        default ""

endmenu
```

## sdkconfig.defaults
```kconfig
# ESP32-P4C5 + AXS15260 6.2 寸 1280x452 歌词显示屏
# 目标：ESP32-P4X（rev v3.x）+ ESP32-C5（ESP-Hosted SDIO Slave）

CONFIG_ESP_MAIN_TASK_STACK_SIZE=8192
CONFIG_LOG_DEFAULT_LEVEL_INFO=y

CONFIG_ESP32P4_SELECTS_REV_LESS_V3=n
CONFIG_ESP32P4_REV_MIN_300=y
CONFIG_ESP_DEFAULT_CPU_FREQ_MHZ_400=y

CONFIG_ESPTOOLPY_FLASHSIZE_16MB=y
CONFIG_ESPTOOLPY_FLASHSIZE="16MB"
CONFIG_PARTITION_TABLE_CUSTOM=y
CONFIG_PARTITION_TABLE_CUSTOM_FILENAME="partitions.csv"

CONFIG_SPIRAM=y
CONFIG_SPIRAM_MODE_HEX=y
CONFIG_SPIRAM_SPEED_200M=y
CONFIG_SPIRAM_XIP_FROM_PSRAM=y
CONFIG_CACHE_L2_CACHE_256KB=y
CONFIG_CACHE_L2_CACHE_LINE_128B=y
CONFIG_ESP_LDO_RESERVE_PSRAM=y
CONFIG_ESP_LDO_CHAN_PSRAM_DOMAIN=2
CONFIG_ESP_LDO_VOLTAGE_PSRAM_1800_MV=y
CONFIG_LCD_DSI_ISR_HANDLER_IN_IRAM=y

CONFIG_IDF_EXPERIMENTAL_FEATURES=y
CONFIG_FREERTOS_HZ=1000
CONFIG_ESP_TASK_WDT_EN=n
CONFIG_FREERTOS_TIMER_TASK_STACK_DEPTH=4096
CONFIG_ESP_CONSOLE_USB_SERIAL_JTAG=y
CONFIG_COMPILER_OPTIMIZATION_PERF=y

# LVGL 9.2：RGB888、libc malloc（自动落 PSRAM）、10ms 刷新
CONFIG_LV_COLOR_DEPTH_24=y
CONFIG_LV_USE_BUILTIN_MALLOC=n
CONFIG_LV_USE_CLIB_MALLOC=y
CONFIG_LV_USE_BUILTIN_STRING=n
CONFIG_LV_USE_CLIB_STRING=y
CONFIG_LV_USE_BUILTIN_SPRINTF=n
CONFIG_LV_USE_CLIB_SPRINTF=y
CONFIG_LV_OS_FREERTOS=y
CONFIG_LV_DEF_REFR_PERIOD=10
CONFIG_LV_OBJ_STYLE_CACHE=y
CONFIG_LV_DRAW_SW_DRAW_UNIT_CNT=2
CONFIG_LV_USE_SYSMON=n
CONFIG_LV_USE_PERF_MONITOR=n
CONFIG_LV_FONT_MONTSERRAT_24=y
CONFIG_LV_FONT_MONTSERRAT_28=y
CONFIG_LV_FONT_MONTSERRAT_32=y
CONFIG_LV_FONT_MONTSERRAT_40=y
CONFIG_LV_FONT_MONTSERRAT_48=y
CONFIG_LV_FONT_DEFAULT_MONTSERRAT_14=y
# 6763 字 CJK 字体需要 large 描述符；lv_font_conv 生成的位图是压缩的
CONFIG_LV_FONT_FMT_TXT_LARGE=y
CONFIG_LV_USE_FONT_COMPRESSED=y

# ESP-Hosted：P4 是 Host，C5 运行 ESP-Hosted-MCU Slave 2.12.9
CONFIG_SLAVE_IDF_TARGET_ESP32C5=y
CONFIG_ESP_HOSTED_IDF_SLAVE_TARGET="esp32c5"
CONFIG_ESP_HOSTED_SDIO_HOST_INTERFACE=y
CONFIG_ESP_HOSTED_SDIO_SLOT_1=y
# 当前 P4X 板 D2/D3 读数异常，Hosted 走 1-bit（D0 数据，D1 中断）
CONFIG_ESP_HOSTED_SDIO_1_BIT_BUS=y
CONFIG_ESP_HOSTED_PRIV_SDIO_PIN_D1_1BIT_BUS_SLOT_1=15
CONFIG_ESP_HOSTED_SDIO_CLOCK_FREQ_KHZ=40000
CONFIG_ESP_HOSTED_PRIV_SDIO_PIN_CMD_SLOT_1=19
CONFIG_ESP_HOSTED_PRIV_SDIO_PIN_CLK_SLOT_1=18
CONFIG_ESP_HOSTED_PRIV_SDIO_PIN_D0_SLOT_1=14
CONFIG_ESP_HOSTED_SDIO_GPIO_RESET_SLAVE=54
CONFIG_ESP_HOSTED_SLAVE_RESET_ON_EVERY_HOST_BOOTUP=y
# CONFIG_ESP_HOSTED_TRANSPORT_RESTART_ON_FAILURE is not set
CONFIG_ESP_HOSTED_SDIO_RESET_DELAY_MS=1500

# WiFi Remote（P4 无射频，走 C5 shim）
CONFIG_ESP_WIFI_REMOTE_ENABLED=y
CONFIG_ESP_WIFI_REMOTE_IN_IDF=y
```
